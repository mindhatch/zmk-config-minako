## config/boards/shields/minako/Kconfig.defconfig
```kconfig
# Copyright (c) 2020 The ZMK Contributors
# SPDX-License-Identifier: MIT

if SHIELD_MINAKO_LEFT

config ZMK_KEYBOARD_NAME
	default "MINAKO_L"

config ZMK_SPLIT_BLE_ROLE_CENTRAL
	default y

endif

if SHIELD_MINAKO_RIGHT

config ZMK_KEYBOARD_NAME
	default "MINAKO_R"

endif

if SHIELD_MINAKO_RIGHT || SHIELD_MINAKO_LEFT

config ZMK_SPLIT
	default y

endif
```

## config/boards/shields/minako/Kconfig.shield
```kconfig
# Copyright (c) 2020 The ZMK Contributors
# SPDX-License-Identifier: MIT

config SHIELD_MINAKO_LEFT
	def_bool $(shields_list_contains,minako_left)

config SHIELD_MINAKO_RIGHT
	def_bool $(shields_list_contains,minako_right)
```
